## child_image/mcuboot/boards/ssci086585_nrf5340_cpuapp.conf
```kconfig
CONFIG_GPIO=y
CONFIG_GPIO_NRFX_INTERRUPT=n

# Turn on a LED so we can see when Serial Recovery mode is active
CONFIG_MCUBOOT_INDICATION_LED=y

# Configure boolader to use two slots
CONFIG_SINGLE_APPLICATION_SLOT=n

# Enable Serial Recovery over UART
CONFIG_BOOT_SERIAL_UART=y
CONFIG_BOOT_SERIAL_CDC_ACM=y

CONFIG_MCUBOOT_SERIAL=y
CONFIG_MCUBOOT_SERIAL_DIRECT_IMAGE_UPLOAD=y

# Disable console UART, since Serial Recovery uses UART
CONFIG_UART_CONSOLE=n

# USB
CONFIG_USB_DEVICE_MANUFACTURER="Switch Science, Inc."
CONFIG_USB_DEVICE_PRODUCT="mcuboot SSCI MDBT53 Dev Board"
CONFIG_USB_DEVICE_VID=0x1915
CONFIG_USB_DEVICE_PID=0x5300
CONFIG_USB_CDC_ACM=y

CONFIG_PM_PARTITION_SIZE_MCUBOOT=0x15000
```

## src/Kconfig
```kconfig
menu "SRC"

module = USER_MAIN
module-str = MAIN
source "subsys/logging/Kconfig.template.log_config"

endmenu
```

## src/app/Kconfig
```kconfig
menu "APP"

module = USER_APP
module-str = APP
source "subsys/logging/Kconfig.template.log_config"

endmenu
```

## src/ble/Kconfig
```kconfig
menu "BLE"

module = USER_BLE
module-str = BLE
source "subsys/logging/Kconfig.template.log_config"

endmenu
```

## src/drivers/Kconfig
```kconfig
menu "Drivers"

rsource "button/Kconfig"
rsource "led/Kconfig"
rsource "sb1602/Kconfig"

endmenu
```

## src/drivers/button/Kconfig
```kconfig
menu "LED"

module = USER_DRV_BUTTON
module-str = DRV_BUTTON
source "subsys/logging/Kconfig.template.log_config"

endmenu
```

## src/drivers/led/Kconfig
```kconfig
menu "LED"

module = USER_DRV_LED
module-str = DRV_LED
source "subsys/logging/Kconfig.template.log_config"

endmenu
```

## src/drivers/sb1602/Kconfig
```kconfig
menu "LCD SB1602"

config USER_DEV_SB1602_CONTRAST
    int "LCD contrast"
    default 32

module = USER_DRV_SB1602
module-str = DRV_SB1602
source "subsys/logging/Kconfig.template.log_config"

endmenu
```

## sysbuild/mcuboot/boards/ssci086585_nrf5340_cpuapp.conf
```kconfig
# Turn on a LED so we can see when Serial Recovery mode is active
CONFIG_GPIO=y
CONFIG_MCUBOOT_INDICATION_LED=y

# Configure boolader to use two slots
CONFIG_SINGLE_APPLICATION_SLOT=n

# MCUboot size(default: 0xc000)
# CONFIG_PM_PARTITION_SIZE_MCUBOOT=0xc000
```
